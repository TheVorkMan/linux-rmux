## drivers/ps4/Kconfig
```kconfig
# SPDX-License-Identifier: GPL-2.0-only
#
# Sony PlayStation 4 platform drivers
#

config PS4_APCIE
	bool "PS4 Aeolia/Belize south bridge PCIe core"
	depends on X86_PS4
	default X86_PS4
	help
	  Core driver for the Sony PlayStation 4 "Aeolia" (and later
	  "Belize"/"Baikal") south bridge. It binds PCI function 4 of the
	  composite southbridge device, programs its per-function BAR
	  windows and the custom shared-MSI routing block, and builds the
	  composite MSI irq domain used by every other PS4 on-chip function
	  driver (GbE, AHCI, SDHCI, xHCI, ICC, ...).

	  This is the foundation for all other PS4 platform drivers; if you
	  are building a kernel for the PlayStation 4, say Y. If unsure,
	  say N.

config PS4_FAN
	tristate "PlayStation 4 Aeolia/Belize fan hwmon driver"
	depends on X86_PS4
	depends on PS4_APCIE
	depends on HWMON
	help
	  hwmon driver for the fan controller on the Sony PlayStation 4
	  Aeolia (CXD90025G) and Belize southbridges. It talks to the
	  southbridge EMC over the Aeolia ICC mailbox and exposes the APU
	  temperature (temp1_input), the fan trip threshold (temp1_crit,
	  read/write, in milli-Celsius), and the fan speed (fan1_input, in
	  RPM) through the standard hwmon sysfs interface, so tools such as
	  lm-sensors and fancontrol work out of the box.

	  This driver requires the PS4 Aeolia APCIE/ICC support.

	  To compile this driver as a module, choose M here: the module will
	  be called ps4-fan.

	  If unsure, say N.

config PS4_LED
	tristate "PlayStation 4 front-panel LED support"
	depends on X86_PS4
	depends on PS4_APCIE
	depends on LEDS_CLASS
	help
	  Say Y here to enable control of the front-panel indicator LED on
	  Sony PlayStation 4 consoles (Aeolia and Belize southbridges). The
	  LED is driven through the Aeolia ICC mailbox and is exposed as a
	  set of LED class devices under /sys/class/leds/ (ps4:blue:status,
	  ps4:white:status, ps4:orange:status and several combined colors).

	  This driver does nothing on non-PS4 hardware.

	  To compile this driver as a module, choose M here: the module will
	  be called ps4-led.
```
